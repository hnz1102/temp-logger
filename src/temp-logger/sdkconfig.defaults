## src/temp-logger/sdkconfig.defaults
```kconfig
CONFIG_ESP_MAIN_TASK_STACK_SIZE=24000
CONFIG_PTHREAD_TASK_STACK_SIZE_DEFAULT=24000
CONFIG_RTC_CLK_SRC=RTC_CLK_SRC_EXT_CRYS
ESP_SYSTEM_RTC_EXT_XTAL=y
```
